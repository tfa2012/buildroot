## configs/acn2952_wpe_yt_defconfig
```kconfig
BR2_mipsel=y
# BR2_MIPS_SOFT_FLOAT is not set
BR2_CCACHE=y
BR2_TOOLCHAIN_EXTERNAL=y
BR2_TOOLCHAIN_EXTERNAL_PATH="/opt/toolchain/acn/"
BR2_TOOLCHAIN_EXTERNAL_CUSTOM_PREFIX="mipsel-buildroot-linux-uclibc"
BR2_TOOLCHAIN_EXTERNAL_GCC_5=y
BR2_TOOLCHAIN_EXTERNAL_HEADERS_3_3=y
BR2_TOOLCHAIN_EXTERNAL_LOCALE=y
BR2_TOOLCHAIN_EXTERNAL_HAS_SSP=y
BR2_TOOLCHAIN_EXTERNAL_INET_RPC=y
BR2_TOOLCHAIN_EXTERNAL_CXX=y
BR2_PACKAGE_HOST_GDB=y
BR2_TARGET_GENERIC_HOSTNAME="acn"
BR2_TARGET_GENERIC_ISSUE="Welcome"
BR2_TARGET_GENERIC_CABUNDLE=y
BR2_TARGET_GENERIC_TIMESERVER="time.nist.gov"
BR2_ROOTFS_DEVICE_CREATION_STATIC=y
BR2_ROOTFS_POST_IMAGE_SCRIPT="board/acn/acn.sh"
BR2_PACKAGE_BUSYBOX_SMP=y
BR2_PACKAGE_GSTREAMER1=y
BR2_PACKAGE_GST1_BCM=y
# BR2_PACKAGE_GST1_BCM_VP9_SUPPORT is not set
BR2_PACKAGE_GST1_PLUGINS_BASE_PLUGIN_APP=y
BR2_PACKAGE_GST1_PLUGINS_BASE_PLUGIN_VIDEOCONVERT=y
BR2_PACKAGE_GST1_PLUGINS_BASE_PLUGIN_GIO=y
BR2_PACKAGE_GST1_PLUGINS_BASE_PLUGIN_OPUS=y
BR2_PACKAGE_GST1_PLUGINS_GOOD_PLUGIN_AUDIOFX=y
BR2_PACKAGE_GST1_PLUGINS_GOOD_PLUGIN_AUDIOPARSERS=y
BR2_PACKAGE_GST1_PLUGINS_GOOD_PLUGIN_AUTODETECT=y
BR2_PACKAGE_GST1_PLUGINS_GOOD_PLUGIN_DEINTERLACE=y
BR2_PACKAGE_GST1_PLUGINS_GOOD_PLUGIN_ICYDEMUX=y
BR2_PACKAGE_GST1_PLUGINS_GOOD_PLUGIN_ID3DEMUX=y
BR2_PACKAGE_GST1_PLUGINS_GOOD_PLUGIN_INTERLEAVE=y
BR2_PACKAGE_GST1_PLUGINS_GOOD_PLUGIN_MATROSKA=y
BR2_PACKAGE_GST1_PLUGINS_GOOD_PLUGIN_SOUPHTTPSRC=y
BR2_PACKAGE_GST1_PLUGINS_BAD_PLUGIN_MPEGTSDEMUX=y
BR2_PACKAGE_GST1_PLUGINS_BAD_PLUGIN_VIDEOPARSERS=y
BR2_PACKAGE_GST1_PLUGINS_BAD_PLUGIN_DASH=y
BR2_PACKAGE_GST1_PLUGINS_BAD_PLUGIN_FAAD=y
BR2_PACKAGE_GST1_PLUGINS_BAD_PLUGIN_HLS=y
BR2_PACKAGE_GST1_PLUGINS_BAD_PLUGIN_OPUS=y
BR2_PACKAGE_GST1_PLUGINS_BAD_PLUGIN_SMOOTHSTREAMING=y
BR2_PACKAGE_GST1_PLUGINS_UGLY=y
BR2_PACKAGE_GST1_PLUGINS_UGLY_PLUGIN_MPG123=y
BR2_PACKAGE_NINJA=y
BR2_PACKAGE_BITSTREAM_VERA=y
BR2_PACKAGE_ACN_SDK=y
BR2_PACKAGE_OPENSSL=y
BR2_PACKAGE_JPEG_TURBO=y
BR2_PACKAGE_LIBMNG=y
BR2_PACKAGE_WEBP=y
BR2_PACKAGE_WPEFRAMEWORK=y
BR2_PACKAGE_WPEFRAMEWORK_PORT="8081"
BR2_PACKAGE_WPEFRAMEWORK_PERSISTENT_PATH="/hdd/metrological/persistent"
BR2_PACKAGE_WPEFRAMEWORK_DATA_PATH="/hdd/metrological/usr/share/WPEFramework"
BR2_PACKAGE_WPEFRAMEWORK_SYSTEM_PATH="/hdd/metrological/usr/lib/wpeframework/plugins"
BR2_PACKAGE_WPEFRAMEWORK_PROXYSTUB_PATH="/hdd/metrological/usr/lib/wpeframework/proxystubs"
BR2_PACKAGE_WPEFRAMEWORK_VIRTUALINPUT=y
BR2_PACKAGE_WPEFRAMEWORK_DEVICEINFO=y
BR2_PACKAGE_WPEFRAMEWORK_LOCATIONSYNC=y
BR2_PACKAGE_WPEFRAMEWORK_MONITOR=y
BR2_PACKAGE_WPEFRAMEWORK_REMOTECONTROL=y
BR2_PACKAGE_WPEFRAMEWORK_SNAPSHOT=y
BR2_PACKAGE_WPEFRAMEWORK_TIMESYNC=y
BR2_PACKAGE_WPEFRAMEWORK_TRACECONTROL=y
BR2_PACKAGE_WPEFRAMEWORK_WEBKITBROWSER=y
BR2_PACKAGE_WPEFRAMEWORK_WEBKITBROWSER_STARTURL="https://www.youtube.com/tv"
BR2_PACKAGE_WPEFRAMEWORK_WEBKITBROWSER_USERAGENT="Mozilla/5.0 (Macintosh, Intel Mac OS X 10_11_4) AppleWebKit/602.1.28+ (KHTML, like Gecko) Version/9.1 Safari/601.5.17, KPN_STB_BCM7241/7.3.31.5002 (Arcadyan, HMB2260, Wired)"
BR2_PACKAGE_WPEFRAMEWORK_WEBKITBROWSER_CLIENTIDENTIFIER="300"
BR2_PACKAGE_WPEFRAMEWORK_WEBKITBROWSER_LOCALSTORAGE="/tmp"
BR2_PACKAGE_WPEFRAMEWORK_WEBKITBROWSER_MEMORYPRESSURE="databaseprocess:30m,networkprocess:40m,webprocess:150m,rpcprocess:30m"
BR2_PACKAGE_WPEFRAMEWORK_DIALSERVER=y
BR2_PACKAGE_WPEWEBKIT=y
BR2_PACKAGE_WPEWEBKIT_ENABLE_NATIVE_AUDIO=y
# BR2_PACKAGE_LIBXKBCOMMON is not set
BR2_PACKAGE_C_ARES=y
BR2_PACKAGE_ORC=y
BR2_PACKAGE_ICU_USE_ICUDATA=y
BR2_PACKAGE_SHARED_MIME_INFO=y
BR2_PACKAGE_UTIL_LINUX_PIVOT_ROOT=y
```

## configs/raspberrypi2_wpe_ml_tv_defconfig
```kconfig
BR2_arm=y
BR2_cortex_a7=y
BR2_ARM_FPU_NEON_VFPV4=y
BR2_ARM_INSTRUCTIONS_THUMB2=y
BR2_CCACHE=y
BR2_OPTIMIZE_2=y
BR2_PACKAGE_HOST_LINUX_HEADERS_CUSTOM_4_9=y
BR2_TOOLCHAIN_BUILDROOT_GLIBC=y
BR2_TOOLCHAIN_BUILDROOT_CXX=y
BR2_ENABLE_LOCALE_PURGE=y
BR2_ENABLE_LOCALE_WHITELIST="C en_US"
BR2_TARGET_GENERIC_CABUNDLE=y
BR2_ROOTFS_DEVICE_CREATION_DYNAMIC_EUDEV=y
BR2_TARGET_GENERIC_ROOT_PASSWD="root"
# BR2_TARGET_GENERIC_GETTY is not set
BR2_SYSTEM_DHCP="eth0"
BR2_ROOTFS_POST_BUILD_SCRIPT="board/raspberrypi2/post-build.sh"
BR2_ROOTFS_POST_IMAGE_SCRIPT="board/raspberrypi2/post-image.sh"
BR2_LINUX_KERNEL=y
BR2_LINUX_KERNEL_CUSTOM_GIT=y
BR2_LINUX_KERNEL_CUSTOM_REPO_URL="https://github.com/raspberrypi/linux.git"
BR2_LINUX_KERNEL_CUSTOM_REPO_VERSION="8bf13deebd582fd64a6595d23e9c965b652ef7c8"
BR2_LINUX_KERNEL_USE_CUSTOM_CONFIG=y
BR2_LINUX_KERNEL_CUSTOM_CONFIG_FILE="board/raspberrypi2/rpi23-linux-4.9-tv.config"
BR2_LINUX_KERNEL_DTS_SUPPORT=y
BR2_LINUX_KERNEL_INTREE_DTS_NAME="bcm2709-rpi-2-b bcm2710-rpi-3-b"
BR2_PACKAGE_BUSYBOX_SMP=y
BR2_PACKAGE_GSTREAMER1=y
BR2_PACKAGE_GST1_PLUGINS_BASE_PLUGIN_APP=y
BR2_PACKAGE_GST1_PLUGINS_BASE_PLUGIN_VIDEOCONVERT=y
BR2_PACKAGE_GST1_PLUGINS_BASE_PLUGIN_GIO=y
BR2_PACKAGE_GST1_PLUGINS_BASE_PLUGIN_ALSA=y
BR2_PACKAGE_GST1_PLUGINS_GOOD_PLUGIN_AUDIOFX=y
BR2_PACKAGE_GST1_PLUGINS_GOOD_PLUGIN_AUDIOPARSERS=y
BR2_PACKAGE_GST1_PLUGINS_GOOD_PLUGIN_AUTODETECT=y
BR2_PACKAGE_GST1_PLUGINS_GOOD_PLUGIN_DEINTERLACE=y
BR2_PACKAGE_GST1_PLUGINS_GOOD_PLUGIN_INTERLEAVE=y
BR2_PACKAGE_GST1_PLUGINS_GOOD_PLUGIN_SOUPHTTPSRC=y
BR2_PACKAGE_GST1_PLUGINS_BAD_PLUGIN_MPEGTSDEMUX=y
BR2_PACKAGE_GST1_PLUGINS_BAD_PLUGIN_VIDEOPARSERS=y
BR2_PACKAGE_GST1_PLUGINS_BAD_PLUGIN_DVB=y
BR2_PACKAGE_GST1_PLUGINS_BAD_PLUGIN_DASH=y
BR2_PACKAGE_GST1_PLUGINS_BAD_PLUGIN_FAAD=y
BR2_PACKAGE_GST1_PLUGINS_BAD_PLUGIN_SMOOTHSTREAMING=y
BR2_PACKAGE_GST1_PLUGINS_BAD_PLUGIN_HLS=y
BR2_PACKAGE_GST1_PLUGINS_UGLY=y
BR2_PACKAGE_GST1_PLUGINS_UGLY_PLUGIN_MPG123=y
BR2_PACKAGE_GST1_LIBAV=y
BR2_PACKAGE_GST_OMX=y
BR2_PACKAGE_INOTIFY_TOOLS=y
BR2_PACKAGE_NINJA=y
BR2_PACKAGE_BITSTREAM_VERA=y
BR2_PACKAGE_RPI_FIRMWARE=y
# BR2_PACKAGE_EUDEV_ENABLE_HWDB is not set
BR2_PACKAGE_RPI_USERLAND=y
BR2_PACKAGE_DVB_APPS=y
BR2_PACKAGE_DVB_WINTV_TUNER=y
BR2_PACKAGE_WPE=y
BR2_PACKAGE_WPEWEBKIT=y
BR2_PACKAGE_WPEWEBKIT_ENABLE_TV_CONTROL=y
BR2_PACKAGE_LIBXKBCOMMON=y
BR2_PACKAGE_LIBPROVISION=y
BR2_PACKAGE_ORC=y
BR2_PACKAGE_ICU_USE_ICUDATA=y
BR2_PACKAGE_SHARED_MIME_INFO=y
BR2_PACKAGE_DROPBEAR=y
BR2_PACKAGE_GESFTPSERVER=y
BR2_PACKAGE_WPEFRAMEWORK=y
BR2_PACKAGE_WPEFRAMEWORK_WEBPROXY=y
BR2_PACKAGE_WPEFRAMEWORK_WEBSERVER=y
BR2_PACKAGE_WPEFRAMEWORK_WEBSHELL=y
BR2_PACKAGE_WPEFRAMEWORK_PROVISIONPROXY=y
BR2_PACKAGE_WPEFRAMEWORK_COMMANDER=y
BR2_PACKAGE_WPEFRAMEWORK_DEVICEINFO=y
BR2_PACKAGE_WPEFRAMEWORK_MONITOR=y
BR2_PACKAGE_WPEFRAMEWORK_TIMESYNC=y
BR2_PACKAGE_WPEFRAMEWORK_TRACECONTROL=y
BR2_PACKAGE_WPEFRAMEWORK_WEBKITBROWSER=y
BR2_PACKAGE_WPEFRAMEWORK_WEBKITBROWSER_STARTURL="http://37.153.111.234"
BR2_PACKAGE_WPEFRAMEWORK_WEBKITBROWSER_MEMORYPRESSURE="databaseprocess:30m,networkprocess:50m,webprocess:170m,rpcprocess:50m"
BR2_PACKAGE_WPEFRAMEWORK_WEBKITBROWSER_DISKCACHE="90m"
BR2_PACKAGE_WPEFRAMEWORK_WEBKITBROWSER_XHRCACHE=y
BR2_PACKAGE_WPEFRAMEWORK_WEBKITBROWSER_TRANSPARENT=y
BR2_PACKAGE_WPEFRAMEWORK_YOUTUBE=y
BR2_TARGET_ROOTFS_INITRAMFS=y
# BR2_TARGET_ROOTFS_TAR is not set
```

## configs/synaptics32hf_wpe_ml_no_westeros_defconfig
```kconfig
BR2_arm=y
BR2_cortex_a9=y
BR2_ARM_ENABLE_NEON=y
BR2_ARM_ENABLE_VFP=y
BR2_ARM_FPU_NEON=y
BR2_ARM_INSTRUCTIONS_THUMB2=y
BR2_CCACHE=y
BR2_OPTIMIZE_2=y
BR2_TOOLCHAIN_BUILDROOT_GLIBC=y
BR2_KERNEL_HEADERS_4_1=y
BR2_TOOLCHAIN_BUILDROOT_CXX=y
BR2_PACKAGE_HOST_GDB=y
BR2_TARGET_OPTIMIZATION="-mtune=cortex-a53"
BR2_TARGET_GENERIC_CABUNDLE=y
BR2_ROOTFS_DEVICE_CREATION_DYNAMIC_EUDEV=y
BR2_TARGET_GENERIC_ROOT_PASSWD="root"
BR2_TARGET_GENERIC_GETTY_PORT="ttyS0"
BR2_SYSTEM_DHCP="eth0"
BR2_ROOTFS_POST_BUILD_SCRIPT="board/synaptics/post-build.sh"
BR2_ROOTFS_POST_IMAGE_SCRIPT="board/synaptics/post-image.sh "
BR2_PACKAGE_BUSYBOX_SMP=y
BR2_PACKAGE_FFMPEG=y
BR2_PACKAGE_GSTREAMER1=y
BR2_PACKAGE_GSTREAMER1_GIT=y
BR2_PACKAGE_GST1_PLUGINS_BASE_PLUGIN_APP=y
BR2_PACKAGE_GST1_PLUGINS_BASE_PLUGIN_VIDEOCONVERT=y
BR2_PACKAGE_GST1_PLUGINS_BASE_PLUGIN_GIO=y
BR2_PACKAGE_GST1_PLUGINS_GOOD_PLUGIN_AUDIOFX=y
BR2_PACKAGE_GST1_PLUGINS_GOOD_PLUGIN_AUDIOPARSERS=y
BR2_PACKAGE_GST1_PLUGINS_GOOD_PLUGIN_AUTODETECT=y
BR2_PACKAGE_GST1_PLUGINS_GOOD_PLUGIN_DEINTERLACE=y
BR2_PACKAGE_GST1_PLUGINS_GOOD_PLUGIN_ICYDEMUX=y
BR2_PACKAGE_GST1_PLUGINS_GOOD_PLUGIN_ID3DEMUX=y
BR2_PACKAGE_GST1_PLUGINS_GOOD_PLUGIN_INTERLEAVE=y
BR2_PACKAGE_GST1_PLUGINS_GOOD_PLUGIN_SOUPHTTPSRC=y
BR2_PACKAGE_GST1_PLUGINS_BAD_PLUGIN_MPEGTSDEMUX=y
BR2_PACKAGE_GST1_PLUGINS_BAD_PLUGIN_VIDEOPARSERS=y
BR2_PACKAGE_GST1_PLUGINS_BAD_PLUGIN_DASH=y
BR2_PACKAGE_GST1_PLUGINS_BAD_PLUGIN_FAAD=y
BR2_PACKAGE_GST1_PLUGINS_BAD_PLUGIN_HLS=y
BR2_PACKAGE_GST1_PLUGINS_BAD_PLUGIN_SMOOTHSTREAMING=y
BR2_PACKAGE_GST1_PLUGINS_UGLY=y
BR2_PACKAGE_GST1_PLUGINS_UGLY_PLUGIN_MPG123=y
BR2_PACKAGE_NETFLIX=y
BR2_PACKAGE_NETFLIX_LIB=y
BR2_PACKAGE_NINJA=y
BR2_PACKAGE_PLAYREADY=y
BR2_PACKAGE_BITSTREAM_VERA=y
BR2_PACKAGE_MARVELL_FIRMWARE=y
BR2_PACKAGE_MARVELL_FIRMWARE_GFX=y
BR2_PACKAGE_MARVELL_AMPSDK=y
BR2_PACKAGE_GST1_SYNA_PLUGIN_WEBKIT=y
BR2_PACKAGE_GST1_SYNA_PLUGIN_UT=y
# BR2_PACKAGE_EUDEV_ENABLE_HWDB is not set
BR2_PACKAGE_EVTEST=y
BR2_PACKAGE_PYTHON=y
BR2_PACKAGE_WPEFRAMEWORK=y
BR2_PACKAGE_WPEFRAMEWORK_PROVISIONPROXY=y
BR2_PACKAGE_WPEFRAMEWORK_LOCATIONSYNC=y
BR2_PACKAGE_WPEFRAMEWORK_REMOTECONTROL=y
BR2_PACKAGE_WPEFRAMEWORK_REMOTECONTROL_DEVUINPUT=y
BR2_PACKAGE_WPEFRAMEWORK_TIMESYNC=y
BR2_PACKAGE_WPEFRAMEWORK_TRACECONTROL=y
BR2_PACKAGE_WPEFRAMEWORK_WEBKITBROWSER=y
BR2_PACKAGE_WPEFRAMEWORK_WEBKITBROWSER_STARTURL="file:///www/index.html"
BR2_PACKAGE_WPEFRAMEWORK_WEBKITBROWSER_USERAGENT="Mozilla/5.0 (Macintosh, Intel Mac OS X 10_11_4) AppleWebKit/602.1.28+ (KHTML, like Gecko) Version/9.1 Safari/601.5.17 WPE-Reference"
BR2_PACKAGE_WPEFRAMEWORK_YOUTUBE=y
BR2_PACKAGE_WPEFRAMEWORK_WEBSERVER=y
BR2_PACKAGE_WPEFRAMEWORK_WIFI=y
BR2_PACKAGE_WPEFRAMEWORK_DIALSERVER=y
BR2_PACKAGE_WPEFRAMEWORK_NETFLIX=y
BR2_PACKAGE_WPEFRAMEWORK_PLUGIN_NETFLIX_AUTOSTART=y
BR2_PACKAGE_WPEFRAMEWORK_PROVISIONING=y
BR2_PACKAGE_WPEWEBKIT=y
BR2_PACKAGE_LIBXKBCOMMON=y
BR2_PACKAGE_CURL=y
BR2_PACKAGE_ORC=y
BR2_PACKAGE_ICU_USE_ICUDATA=y
BR2_PACKAGE_SHARED_MIME_INFO=y
BR2_PACKAGE_BLUEZ5_UTILS=y
BR2_PACKAGE_BLUEZ5_UTILS_CLIENT=y
BR2_PACKAGE_DROPBEAR=y
BR2_PACKAGE_GESFTPSERVER=y
BR2_PACKAGE_WIRELESS_TOOLS=y
BR2_PACKAGE_WPA_SUPPLICANT_PASSPHRASE=y
BR2_TARGET_ROOTFS_CPIO=y
BR2_TARGET_ROOTFS_CPIO_UIMAGE=y
```

## package/cjson/Config.in
```kconfig
config BR2_PACKAGE_CJSON
	bool "cJSON"
	help
	  An ultra-lightweight, portable, single-file, simple-as-can-be ANSI-C
	  compliant JSON parser, under MIT license.

	  https://github.com/DaveGamble/cJSON

if BR2_PACKAGE_CJSON
choice
        prompt "cJSON Version"
	default BR2_PACKAGE_CJSON_VERSION_1.4 if !BR2_PACKAGE_PARODUS
	default BR2_PACKAGE_CJSON_VERSION_1.7 if BR2_PACKAGE_PARODUS

	menuconfig BR2_PACKAGE_CJSON_VERSION_1.4
	bool "cJSON-1.4"
        help
          cJSON version 1.4

	menuconfig BR2_PACKAGE_CJSON_VERSION_1.7
	bool "cJSON-1.7"
        help
          cJSON version 1.7
endchoice
endif
```

## package/cjwt/Config.in
```kconfig
config BR2_PACKAGE_CJWT
    bool "cjwt"
    default n
    help
       Recipe to build c library for processing jwt token
```

## package/msgpack-c/Config.in
```kconfig
config BR2_PACKAGE_MSGPACK-C
    bool "msgpack-c"
    default n
    help
      MessagePack implementation for C and C++
```

## package/netflix43/Config.in
```kconfig
config BR2_PACKAGE_NETFLIX43
	bool "netflix 4.3"
	select BR2_PACKAGE_LIBMNG
	select BR2_PACKAGE_LIBPNG
	select BR2_PACKAGE_ICU
	select BR2_PACKAGE_JPEG
	select BR2_PACKAGE_WEBP
	select BR2_PACKAGE_HARFBUZZ
	select BR2_PACKAGE_FREETYPE
	select BR2_PACKAGE_EXPAT
	select BR2_PACKAGE_OPENSSL
	select BR2_PACKAGE_C_ARES
	select BR2_PACKAGE_LIBCURL
	select BR2_PACKAGE_GRAPHITE2
	select BR2_PACKAGE_LIBVPX
	select BR2_PACKAGE_TREMOR
	select BR2_PACKAGE_LIBVORBIS
	select BR2_PACKAGE_LIBOGG
	select BR2_PACKAGE_NGHTTP2
	select BR2_PACKAGE_FFMPEG
	help
	  Netflix5

if BR2_PACKAGE_NETFLIX43

menu "Extra options"

choice
	bool "Application type"
	default BR2_PACKAGE_NETFLIX43_APP
	help
	  Choose application type.

config BR2_PACKAGE_NETFLIX43_APP
	bool "executable"
	help
	  Create Netflix standalone app.

config BR2_PACKAGE_NETFLIX43_LIB
	bool "library"
	help
	  Create Netflix library.

endchoice

config BR2_PACKAGE_NETFLIX43_KEYMAP
	string "keymap"
	help
	  Install custom keymap

config BR2_PACKAGE_NETFLIX43_GST_GL
	bool "gl"
	depends on BR2_PACKAGE_GST1_PLUGINS_BAD_PLUGIN_GL
	default y

config BR2_PACKAGE_NETFLIX43_MARVEL
	bool "marvel"
	depends on BR2_PACKAGE_MARVELL_AMPSDK
	default n

config BR2_PACKAGE_NETFLIX43_WESTEROS_SINK
	bool "westeros-sink"
	depends on BR2_PACKAGE_WPEFRAMEWORK_COMPOSITOR
	default n

endmenu

endif
```

## package/parodus/Config.in
```kconfig
config BR2_PACKAGE_PARODUS
    bool "parodus"
    default n
    select BR2_PACKAGE_NOPOLL
    select BR2_PACKAGE_NANOMSG
    select BR2_PACKAGE_MSGPACK_C
    select BR2_PACKAGE_UCRESOLV
    select BR2_PACKAGE_TROWER_BASE64
    select BR2_PACKAGE_CIMPLOG
    select BR2_PACKAGE_WRP_C
    select BR2_PACKAGE_WDMP_C
    select BR2_PACKAGE_CJSON
    help
       parodus client library
```

## package/playgiga/Config.in
```kconfig
config BR2_PACKAGE_PLAYGIGA
	bool "playgiga"
	select BR2_PACKAGE_FFMPEG
	select BR2_PACKAGE_SDL2
	select BR2_PACKAGE_OPENAL
	select BR2_PACKAGE_LIBCURL
	help
	  PlayGiga SDK.
```

## package/synaptics/Config.in
```kconfig
config BR2_PACKAGE_HAS_BERLIN
        bool

config BR2_PACKAGE_PROVIDES_BERLIN
        depends on BR2_PACKAGE_HAS_BERLIN
        string

source "package/synaptics/marvell-firmware/Config.in"
source "package/synaptics/marvell-ampsdk/Config.in"
source "package/synaptics/gst1-syna-playersinkbin/Config.in"
source "package/synaptics/gst1-syna-plugin/Config.in"
source "package/synaptics/gst1-syna-plugin-webkit/Config.in"
source "package/synaptics/gst1-syna-plugin-ut/Config.in"
```

## package/synaptics/gst1-syna-playersinkbin/Config.in
```kconfig
config BR2_PACKAGE_GST1_SYNA_PLAYERSINKBIN
	bool "gst1-syna-playersinkbin"
	select BR2_PACKAGE_GST1_PLUGINS_BASE
	help
	  GStreamer element for Synaptics

	  https://github.com/thaytan/gst-rpicamsrc
```

## package/synaptics/gst1-syna-plugin-ut/Config.in
```kconfig
config BR2_PACKAGE_GST1_SYNA_PLUGIN_UT
	bool "gst1-syna-plugin-ut"
	select BR2_PACKAGE_GST1_PLUGINS_BASE
	help
	  GStreamer element for Synaptics

	  https://github.com/thaytan/gst-rpicamsrc
```

## package/synaptics/gst1-syna-plugin-webkit/Config.in
```kconfig
config BR2_PACKAGE_GST1_SYNA_PLUGIN_WEBKIT
	bool "gst1-syna-plugin-webkit"
	select BR2_PACKAGE_GST1_PLUGINS_BASE
	help
	  GStreamer element for Synaptics

	  https://github.com/thaytan/gst-rpicamsrc
```

## package/synaptics/gst1-syna-plugin/Config.in
```kconfig
config BR2_PACKAGE_GST1_SYNA_PLUGIN
	bool "gst1-syna-plugin"
	select BR2_PACKAGE_GST1_PLUGINS_BASE
	select BR2_PACKAGE_FFMPEG
	select BR2_PACKAGE_FFMPEG_SWSCALE
	help
	  GStreamer element for Synaptics

	  https://github.com/thaytan/gst-rpicamsrc
```

## package/synaptics/gst1-syna-videosink/Config.in
```kconfig
config BR2_PACKAGE_GST1_SYNA_VIDEOSINK
	bool "gst1-syna-videosink"
	select BR2_PACKAGE_GST1_PLUGINS_BASE
	help
	  GStreamer video sink element for Synaptics

	  https://github.com/thaytan/gst-rpicamsrc
```

## package/trower-base64/Config.in
```kconfig
config BR2_PACKAGE_TROWER-BASE64
    bool "trower-base64"
    default n
    help
      C implementation of base64 encode/decode
```

## package/wdmp-c/Config.in
```kconfig
config BR2_PACKAGE_WDMP-C
    bool "wdmp-c"
    default n
    help
     C library for WebPA Data Model Parser (WDMP)
```
