## package/wpe/wpeframework-espial/Config.in
```kconfig
if BR2_PACKAGE_UMA_SDK

menuconfig BR2_PACKAGE_WPEFRAMEWORK_ESPIAL
    bool "Espial"
    depends on BR2_arm 
    help
        WPE Platform Espial Browser plugin

if BR2_PACKAGE_WPEFRAMEWORK_ESPIAL

config BR2_PACKAGE_WPEFRAMEWORK_ESPIAL_AUTOSTART
    bool "autostart"
    default n

config BR2_PACKAGE_WPEFRAMEWORK_ESPIAL_URL
    string "URL"
    default "http://www.google.com"

endif

comment "Espial Browser is dependent on the ARM architecture"
    depends on !BR2_arm

endif
```

## package/wpe/wpeframework-ocast/Config.in
```kconfig
config BR2_PACKAGE_WPEFRAMEWORK_OCAST
    bool "Ocast"
    help
        WPE Platform Ocast Plugin
```

## package/wpe/wpeframework-webpa/Config.in
```kconfig
config BR2_PACKAGE_WPEFRAMEWORK_WEBPA
	bool "WebPA"
	select BR2_PACKAGE_LIBPARODUS
	select BR2_PACKAGE_TINYXML
	help
	   WPE Platform AVNClient plugin

if BR2_PACKAGE_WPEFRAMEWORK_WEBPA
config BR2_PACKAGE_WPEFRAMEWORK_WEBPA_AUTOSTART
	bool "autostart"
	default n
config BR2_PACKAGE_WPEFRAMEWORK_WEBPA_OOP
	bool "outofprocess"
        default y
config BR2_PACKAGE_WPEFRAMEWORK_WEBPA_DEVICE_INFO
	bool "device info"
	default y
config BR2_PACKAGE_WPEFRAMEWORK_WEBPA_SERVICE
	bool "parodus service"
	default y
endif
```

## package/wpe/wpetvcontrol/Config.in
```kconfig
config BR2_PACKAGE_WPETVCONTROL
	bool "wpetvcontrol"
    select BR2_PACKAGE_CPPSDK
    select BR2_PACKAGE_CPPSDK_RPC
    select BR2_PACKAGE_CPPSDK_WEBSOCKET
    default y
	help
	  Base library for TVControl API.
```

## package/wrp-c/Config.in
```kconfig
config BR2_PACKAGE_WRP-C
    bool "wrp-c"
    default n
    help
      C library for Web Routing Protocol (WRP)
```
